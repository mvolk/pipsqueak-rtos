## main/Kconfig.projbuild
```kconfig
menu "Pipsqueak"
    menu "WiFi"
        config PSQ4_WIFI_SSID
            string "WiFi SSID"
            default "myssid"
            help
                The SSID (network name) of a WiFi access point.

        config PSQ4_WIFI_PASSWORD
            string "WiFi Password"
            default "mypassword"
            help
                The password (WPA or WPA2) for the WiFi access point.
    endmenu

    menu "AWS IoT Thing"
        config AWS_IOT_THING_ARN
            string "IoT Thing ARN"
            default "arn:value:not:specified"
            help
                AWS IoT ARN unique to this device. Begins with "arn:".

        config AWS_IOT_THING_NAME
            string "IoT Thing Name"
            default "thing-name"
            help
                The name given to the AWS IoT Thing representing this device.

                Thing names should consist of lower case letters, numbers, and dashes.

                The Thing name is used in MQTT topic naming, which is case-sensitive
                and limited to letters, numbers and dashes. The use of upper case
                letters in MQTT topic (and by extension, Thing) names is discouraged.
    endmenu

    menu "SPI Bus"
        config PSQ4_SPI_MISO_GPIO
            int "MISO I/O Pin"
            range 0 33
            default 12
            help
                GPIO number (IOxx) serving as the SPI MISO signal carrier.

                Some GPIOs are used for other purposes (flash connections, etc.) and cannot be used.

                GPIOs 34-39 are input-only so cannot be used to drive the One Wire Bus.

                GPIO 12 by default.

        config PSQ4_SPI_MOSI_GPIO
            int "MOSI I/O Pin"
            range 0 33
            default 13
            help
                GPIO number (IOxx) serving as the SPI MOSI signal carrier.

                Some GPIOs are used for other purposes (flash connections, etc.) and cannot be used.

                GPIOs 34-39 are input-only so cannot be used to drive the One Wire Bus.

                GPIO 13 by default.

        config PSQ4_SPI_CLK_GPIO
            int "Clock I/O Pin"
            range 0 33
            default 14
            help
                GPIO number (IOxx) serving as the SPI clock signal carrier.

                Some GPIOs are used for other purposes (flash connections, etc.) and cannot be used.

                GPIOs 34-39 are input-only so cannot be used to drive the One Wire Bus.

                GPIO 14 by default.

        config PSQ4_SPI_HOST
            int "SPI Host"
            range 1 2
            default 1
            help
              The SPI host that the Pipsqueak's SPI peripheral interface will use.

              HSPI (1) or VSPI (2).

              HSPI (1) by default.

        config PSQ4_SPI_DMA_CHANNEL
            int "DMA Channel"
            range 1 2
            default 2
            help
                The DMA channel that the Pipsqueak's SPI peripheral interface will use.

                There are two DMA channels available for use by the SPI hosts: channel
                1 and channel 2.

                Channel 2 by default.
    endmenu

    menu "I2C Interface"
        config PSQ4_I2C_SCL_GPIO
            int "I2C SCL I/O Pin"
            range 0 33
            default 22
            help
                GPIO number (IOxx) used as the clock line for the I2C interface with the external
                real time clock.

                Some GPIOs are used for other purposes (flash connections, etc.) and cannot be used.

                GPIOs 34-39 are input-only so cannot be used to drive the One Wire Bus.

          config PSQ4_I2C_SDA_GPIO
            int "I2C SDA I/O Pin"
            range 0 33
            default 21
            help
              GPIO number (IOxx) used as the data line for the I2C interface with the external
              real time clock.

                Some GPIOs are used for other purposes (flash connections, etc.) and cannot be used.

                GPIOs 34-39 are input-only so cannot be used to drive the One Wire Bus.
    endmenu

    menu "1-Wire Interface"
        config PSQ4_DS18B20_GPIO
            int "DS18B20 1-Wire I/O Pin"
            range 0 33
            default 18
            help
                GPIO number (IOxx) to access the One Wire Bus to which the external temperature
                sensor - and only the external temperature sensor - is connected.

                Some GPIOs are used for other purposes (flash connections, etc.) and cannot be used.

                GPIOs 34-39 are input-only so cannot be used to drive the One Wire Bus.
    endmenu

    menu "Display"
        config PSQ4_DISPLAY_CS_GPIO
            int "Display's Chip Selector (CS) I/O Pin"
            range 0 33
            default 27
            help
                GPIO number (IOxx) connected to the display panel's SPI chip select (CS) pin.

                This pin must be connected.

        config PSQ4_DISPLAY_DC_GPIO
            int "Display's Data/Command Selector (DC) I/O Pin"
            range 0 33
            default 25
            help
                GPIO number (IOxx) connected to the display panel's data/command (DC) selector pin.

                This pin must be connected.

        config PSQ4_DISPLAY_BCKL_GPIO
            int "Display's Backlight I/O Pin"
            range -1 33
            default 32
            help
                GPIO number (IOxx) connected to the display panel's backlight pin.

                Specify -1 if the backlight pin is not connected.

        config PSQ4_DISPLAY_RST_GPIO
            int "Display's Reset (RST) I/O Pin"
            range -1 33
            default 26
            help
                GPIO number (IOxx) connected to the display panel's reset pin.

                Specify -1 if the reset pin is not connected.

    endmenu

    config PSQ4_USE_SNTP
        bool "Use SNTP (recommended in production)"
        default false
        help
            Use SNTP to keep system and external clock drift in check.

            If disabled and the external RTC battery is not installed or goes dead, then features
            requiring accurate time will not function.

            Considerable disabling during development work to avoid excessive requests to SNTP
            servers.
endmenu
```
